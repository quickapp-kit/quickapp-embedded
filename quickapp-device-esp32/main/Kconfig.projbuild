## quickapp-device-esp32/main/Kconfig.projbuild
```kconfig
menu "QuickApp Device Pin Configuration"

    comment "--- SPI Bus (LCD + Touch shared) ---"

    config QA_LCD_MOSI
        int "SPI MOSI GPIO"
        default 11
        help
            SPI MOSI pin, shared by ILI9341 and XPT2046.

    config QA_LCD_MISO
        int "SPI MISO GPIO"
        default 13
        help
            SPI MISO pin, shared by ILI9341 and XPT2046.

    config QA_LCD_SCLK
        int "SPI SCLK GPIO"
        default 12
        help
            SPI clock pin, shared by ILI9341 and XPT2046.

    comment "--- LCD (ILI9341) ---"

    config QA_LCD_CS
        int "LCD CS GPIO"
        default 10
        help
            SPI chip select for ILI9341 display.

    config QA_LCD_DC
        int "LCD DC GPIO"
        default 5
        help
            Data/Command pin for ILI9341 display.

    config QA_LCD_RST
        int "LCD RST GPIO"
        default 4
        help
            Reset pin for ILI9341 display. Set -1 if not connected.

    config QA_LCD_BL
        int "LCD Backlight GPIO"
        default 6
        help
            Backlight control pin. High = on. Set -1 if always on.

    comment "--- Touch (XPT2046) ---"

    config QA_TP_CS
        int "Touch CS GPIO"
        default 7
        help
            SPI chip select for XPT2046 touch controller.

    config QA_TP_IRQ
        int "Touch IRQ GPIO"
        default 8
        help
            Touch interrupt pin (active low). Set -1 to use polling only.

    comment "--- Display Geometry ---"

    config QA_DISPLAY_WIDTH
        int "Display width (pixels)"
        default 240

    config QA_DISPLAY_HEIGHT
        int "Display height (pixels)"
        default 320

endmenu
```

## quickapp-device-esp32/sdkconfig.defaults
```kconfig
# ESP32-S3-N16R8 基础配置
CONFIG_IDF_TARGET="esp32s3"

# Flash: 16MB, QIO 80MHz
CONFIG_ESPTOOLPY_FLASHSIZE_16MB=y
CONFIG_ESPTOOLPY_FLASHMODE_QIO=y
CONFIG_ESPTOOLPY_FLASHFREQ_80M=y
CONFIG_PARTITION_TABLE_CUSTOM=y
CONFIG_PARTITION_TABLE_CUSTOM_FILENAME="partitions.csv"

# PSRAM: 8MB Octal
CONFIG_SPIRAM=y
CONFIG_SPIRAM_MODE_OCT=y
CONFIG_SPIRAM_SPEED_80M=y
CONFIG_SPIRAM_MALLOC_ALWAYSINTERNAL=4096
CONFIG_SPIRAM_TRY_ALLOCATE_WIFI_LWIP=n

# FreeRTOS
CONFIG_FREERTOS_HZ=1000
CONFIG_ESP_MAIN_TASK_STACK_SIZE=65536

# C++ (no exceptions, no RTTI — 与 Runtime 库一致, 节省空间)
CONFIG_COMPILER_CXX_EXCEPTIONS=n
CONFIG_COMPILER_CXX_RTTI=n
CONFIG_COMPILER_OPTIMIZATION_PERF=y

# SPI: ILI9341 + XPT2046 共享 SPI2_HOST
# (引脚配置通过 Kconfig.projbuild 设置)

# SPIFFS (RPK 存储分区)
CONFIG_SPIFFS_MAX_PARTITIONS=2

# 显示分辨率 (ILI9341: 240x320)
CONFIG_QA_DISPLAY_WIDTH=240
CONFIG_QA_DISPLAY_HEIGHT=320

# GPIO 引脚配置 (与硬件报告接线方案一致)
CONFIG_QA_LCD_MOSI=11
CONFIG_QA_LCD_MISO=13
CONFIG_QA_LCD_SCLK=12
CONFIG_QA_LCD_CS=10
CONFIG_QA_LCD_DC=5
CONFIG_QA_LCD_RST=4
CONFIG_QA_LCD_BL=6
CONFIG_QA_TP_CS=7
CONFIG_QA_TP_IRQ=8

# 看门狗: 增加超时 (初始化较慢)
CONFIG_ESP_TASK_WDT_TIMEOUT_S=10

# 日志级别
CONFIG_LOG_DEFAULT_LEVEL_INFO=y
```
